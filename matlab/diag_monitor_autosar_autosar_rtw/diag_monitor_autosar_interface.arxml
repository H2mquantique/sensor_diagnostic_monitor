AUTOSAR XML (schema 00049)
package /Interfaces
  9 x sender receiver interface:
    v1
      data v1: category=VALUE, sw-calibration-access=READ-ONLY, type=Double
    v2
      data v2: category=VALUE, sw-calibration-access=READ-ONLY, type=Double
    rpm
      data rpm: category=VALUE, sw-calibration-access=READ-ONLY, type=Double
    load
      data load: category=VALUE, sw-calibration-access=READ-ONLY, type=Double
    ect
      data ect: category=VALUE, sw-calibration-access=READ-ONLY, type=Double
    state
      data state: category=VALUE, sw-calibration-access=READ-ONLY, type=UInt8
    dtc
      data dtc: category=VALUE, sw-calibration-access=READ-ONLY, type=UInt8
    mil
      data mil: category=VALUE, sw-calibration-access=READ-ONLY, type=Boolean
    ff_valid
      data ff_valid: category=VALUE, sw-calibration-access=READ-ONLY, type=Boolean
