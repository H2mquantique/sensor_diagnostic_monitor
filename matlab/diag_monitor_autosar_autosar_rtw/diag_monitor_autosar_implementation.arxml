AUTOSAR XML (schema 00049)
package /Components/SwcImplementations
  swc implementation diag_monitor_autosar_Impl: programming-language=C, sw-version=1.2.1, used-code-generator=Embedded Coder 7.9 (R2022b) 13-May-2022, vendor-id=0, behavior=diag_monitor_autosar_IB
    code-descriptors:
      code Code
        artifact-descriptors:
          short-label=diag_monitor_autosar_c, category=SWSRC
          short-label=diag_monitor_autosar_h, category=SWHDR
          short-label=diag_monitor_autosar_private_h, category=SWHDR
          short-label=diag_monitor_autosar_types_h, category=SWHDR
          short-label=rtwtypes_h, category=SWHDR
    resource consumption RsrcCons_diag_monitor_autosar
